## base_external/package/aesdchar/Config.in
```kconfig
config BR2_PACKAGE_AESDCHAR
	bool "aesdchar"
	help
	  Linux AESD Char Driver.
	  Builds and installs aesdchar kernel module.
```

## base_external/package/ldd/Config.in
```kconfig
config BR2_PACKAGE_LDD
	bool "ldd"
	help
	  Linux Device Drivers examples package.
	  Builds and installs misc-modules and scull kernel modules.
```
